/*
 * Copyright (c) 2020 The ZMK Contributors
 *
 * SPDX-License-Identifier: MIT
 */

 #include <physical_layouts.dtsi>

 &physical_layout0 {
    compatible = "zmk,physical-layout";
    display-name = "Default Layout";
 };
