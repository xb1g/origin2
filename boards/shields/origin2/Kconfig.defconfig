## boards/shields/origin2/Kconfig.defconfig
```kconfig
if SHIELD_ORIGIN2_LEFT

config ZMK_KEYBOARD_NAME
    default "Origin2"

config ZMK_SPLIT_ROLE_CENTRAL
    default y

endif

if SHIELD_ORIGIN2_LEFT || SHIELD_ORIGIN2_RIGHT

config ZMK_SPLIT
    default y

endif
```

## boards/shields/origin2/Kconfig.shield
```kconfig
config SHIELD_ORIGIN2_LEFT
    def_bool $(shields_list_contains,origin2_left)

config SHIELD_ORIGIN2_RIGHT
    def_bool $(shields_list_contains,origin2_right)
```
